## custom_linux_module/Kconfig
```kconfig
# SPDX-License-Identifier: GPL-2.0

config NFDEV_MODULE
	tristate "Netfilter control device"
	depends on NETFILTER && INET
	default y
	help
	  Build a character-device control interface.
```
